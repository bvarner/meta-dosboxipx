## conf/layer.conf
```bitbake
# meta-dosboxipx - A bitbake layer for a standalone dosbox IPX server.
BBPATH .= ":${LAYERDIR}"

# Add recipes and images
BBFILES += "${LAYERDIR}/recipes*/*/*.bb \
            ${LAYERDIR}/recipes*/*/*.bbappend \
            ${LAYERDIR}/images/*.bb \
            ${LAYERDIR}/images/*.bbappend"

BBFILE_COLLECTIONS += "meta-dosboxipx"
BBFILE_PATTERN_meta-dosboxipx := "^${LAYERDIR}/"
BBFILE_PRIORITY_meta-dosboxipx = "8"

LAYERSERIES_COMPAT_meta-dosboxipx = "gatesgarth"
```
